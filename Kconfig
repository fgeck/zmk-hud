## Kconfig
```kconfig
# SPDX-License-Identifier: MIT
# Root Kconfig that includes firmware module

rsource "firmware/Kconfig"
```

## config/west.yml
```yaml
manifest:
  remotes:
    - name: zmkfirmware
      url-base: https://github.com/zmkfirmware
    - name: zzeneg
      url-base: https://github.com/zzeneg
    - name: anywhy-io
      url-base: https://github.com/anywhy-io
  projects:
    - name: zmk
      remote: zmkfirmware
      revision: main
      import: app/west.yml
    - name: zmk-raw-hid
      remote: zzeneg
      revision: main
    - name: flake-zmk-module
      remote: anywhy-io
      revision: main
  self:
    path: config
```

## firmware/Kconfig
```kconfig
# SPDX-License-Identifier: MIT

config ZMK_HUD
    bool "ZMK HUD Broadcaster"
    default n
    depends on RAW_HID
    depends on !ZMK_SPLIT || ZMK_SPLIT_ROLE_CENTRAL
    help
      Broadcasts layer state and key press events via Raw HID
      for use with desktop HUD applications.

      When enabled, the keyboard will send HID reports containing:
      - Layer activation/deactivation events
      - Key press/release events with position and modifier state

      Requires the zmk-raw-hid module to be enabled.
```
